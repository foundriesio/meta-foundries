## docs/guides/uno-q-wrynose/workarounds/meta-unoq-m05/conf/layer.conf
```bitbake
BBPATH .= ":${LAYERDIR}"
BBFILES += "${LAYERDIR}/recipes-*/*/*.bbappend"
BBFILE_COLLECTIONS += "unoq-m05"
BBFILE_PATTERN_unoq-m05 = "^${LAYERDIR}/"
BBFILE_PRIORITY_unoq-m05 = "10"
LAYERDEPENDS_unoq-m05 = "core qcom-arduino"
LAYERSERIES_COMPAT_unoq-m05 = "wrynose"
```
